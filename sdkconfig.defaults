## sdkconfig.defaults
```kconfig
# 关闭第二路 USB Serial/JTAG 控制台。GPIO19/GPIO20 已被 AIR780E 的 USB OTG 占用，
# 不能让控制台抢占原生 USB 外设。
CONFIG_ESP_CONSOLE_SECONDARY_NONE=y

# 匹配 AIR780E 的 USB Host 需求。
CONFIG_USB_HOST_CONTROL_TRANSFER_MAX_SIZE=2048
CONFIG_USB_HOST_DEBOUNCE_DELAY_MS=500
CONFIG_USB_HOST_RESET_HOLD_MS=100
CONFIG_USB_HOST_RESET_RECOVERY_MS=100
CONFIG_USB_HOST_SET_ADDR_RECOVERY_MS=50

# `iot_usbh_modem` 2.x 依赖的 `iot_usbh_cdc` 3.x 选项。
CONFIG_USBH_CDC_CONTROL_TRANSFER_BUFFER_SIZE=1024

# 4G PPP 拨号需要 lwIP PPP 支持
CONFIG_LWIP_PPP_SUPPORT=y
CONFIG_LWIP_PPP_NOTIFY_PHASE_SUPPORT=y

# R8N8 模组：8MB Flash + 8MB PSRAM (Octal SPI)
CONFIG_ESPTOOLPY_FLASHSIZE_8MB=y
CONFIG_ESPTOOLPY_FLASHSIZE="8MB"
CONFIG_SPIRAM=y
CONFIG_SPIRAM_MODE_OCT=y
CONFIG_SPIRAM_SPEED_80M=y
CONFIG_SPIRAM_BOOT_INIT=y
CONFIG_SPIRAM_USE_MALLOC=y

# FreeRTOS tick 1ms 精度
CONFIG_FREERTOS_HZ=1000

# 自定义分区表
CONFIG_PARTITION_TABLE_CUSTOM=y
CONFIG_PARTITION_TABLE_CUSTOM_FILENAME="partitions.csv"

# `W5500` 直接从 `pin_map.h` 初始化，但仍保留与 Kconfig 一致的以太网默认值。
CONFIG_ETH_USE_SPI_ETHERNET=y
CONFIG_ETH_SPI_ETHERNET_W5500=y
CONFIG_ETH_TRANSMIT_MUTEX=y
CONFIG_ETHERNET_SPI_DEV0_W5500=y
CONFIG_ETHERNET_SPI_SCLK_GPIO=7
CONFIG_ETHERNET_SPI_MOSI_GPIO=5
CONFIG_ETHERNET_SPI_MISO_GPIO=6
CONFIG_ETHERNET_SPI_CLOCK_MHZ=8
CONFIG_ETHERNET_SPI_CS0_GPIO=17
CONFIG_ETHERNET_SPI_INT0_GPIO=4
CONFIG_ETHERNET_SPI_PHY_RST0_GPIO=18
CONFIG_ETHERNET_SPI_PHY_ADDR0=1
```
